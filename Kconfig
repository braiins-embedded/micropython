## Kconfig
```kconfig
menu "Micropython"

source "$MICROPYTHON_DIR/lib/Kconfig"
source "$MICROPYTHON_DIR/drivers/Kconfig"
source "$MICROPYTHON_DIR/extmod/Kconfig"
endmenu
```

## drivers/Kconfig
```kconfig
menu "Drivers"
config MICROPYTHON_DRIVERS_CC3K
       bool "CC3000 Support"
       default n
       ---help---
         Enables support for CC3000 wireless module.

config MICROPYTHON_DRIVERS_CC3100
       bool "CC3100 Support"
       default n
       ---help---
         Enables support for CC3100 wireless module.

config MICROPYTHON_DRIVERS_WIZNET5K
       bool "Wiznet 5K Support"
       default n
       ---help---
         Enables support for WIZnet5x00 series of Ethernet controllers

config MICROPYTHON_DRIVERS_WIZNET5K_TYPE_W5200
       bool

config MICROPYTHON_DRIVERS_WIZNET5K_TYPE_W5500
       bool

config MICROPYTHON_DRIVERS_WIZNET5K_TYPE
       string
       default "w5200" if MICROPYTHON_DRIVERS_WIZNET5K_TYPE_W5200
       default "w5500" if MICROPYTHON_DRIVERS_WIZNET5K_TYPE_W5500

endmenu
```

## extmod/Kconfig
```kconfig
menu "External modules"
config MICROPYTHON_EXTMOD_PY_USSL
       bool "MicroSSL module support"
       default n
       ---help---
         Micropython module for uSSL library

endmenu
```

## lib/Kconfig
```kconfig
menu "Libraries"

config MICROPYTHON_READLINE
       bool "Readline support"
       default y

config MICROPYTHON_FATFS
       bool "FATFS support"
       default n

config MICROPYTHON_LIBC
       bool "C Library Support"
       default y

config MICROPYTHON_LIBM
       bool "Math Library Support"
       default y

config MICROPYTHON_NETUTILS
       bool "Network Utils"
       default n

config MICROPYTHON_TIMEUTILS
       bool "Time Utils"
       default y

config MICROPYTHON_UTILS
       bool "General Utils"
       default y

endmenu
```

## stmhal/Kconfig
```kconfig
menu "STM Hal"

config MICROPYTHON_STMHAL_MCU_SERIES_STM32F4
       bool
config MICROPYTHON_STMHAL_MCU_SERIES_STM32F7
       bool

config MICROPYTHON_STMHAL_CMSIS_MCU_STM32F401XE
       bool
config MICROPYTHON_STMHAL_CMSIS_MCU_STM32F405XX
       bool
config MICROPYTHON_STMHAL_CMSIS_MCU_STM32F407XX
       bool
config MICROPYTHON_STMHAL_CMSIS_MCU_STM32F411XE
       bool
config MICROPYTHON_STMHAL_CMSIS_MCU_STM32F746XX
       bool


config MICROPYTHON_STMHAL_MCU_SERIES
	string
	default "f4"       if MICROPYTHON_STMHAL_MCU_SERIES_STM32F4
	default "f7"	   if MICROPYTHON_STMHAL_MCU_SERIES_STM32F7


config MICROPYTHON_STMHAL_CMSIS_MCU
	string
	default "STM32F401xE"  if MICROPYTHON_STMHAL_CMSIS_MCU_STM32F401XE
	default "STM32F405xx"  if MICROPYTHON_STMHAL_CMSIS_MCU_STM32F405XX
	default "STM32F407xx"  if MICROPYTHON_STMHAL_CMSIS_MCU_STM32F407XX
	default "STM32F411xE"  if MICROPYTHON_STMHAL_CMSIS_MCU_STM32F411XE
	default "STM32F746xx"  if MICROPYTHON_STMHAL_CMSIS_MCU_STM32F746XX

choice
	prompt "Select STM32F Board"
	default MICROPYTHON_STMHAL_BOARD_STM32F4DISC
	config MICROPYTHON_STMHAL_BOARD_STM32F4DISC
	       bool "STM32F4 Discovery board"
	config MICROPYTHON_STMHAL_BOARD_STM32F411DISC
	       bool "STM32F411 Discovery board"
endchoice

# Micropython defaults common for all boards
config MICROPYTHON_STMHAL
       bool
       select MICROPYTHON_READLINE
       select MICROPYTHON_FATFS
       select MICROPYTHON_LIBC
       select MICROPYTHON_LIBM
       select MICROPYTHON_NETUTILS
       select MICROPYTHON_TIMEUTILS
       select MICROPYTHON_UTILS
       default y

# board specific Kconfig selects defaults for each board
source "$MICROPYTHON_STMHAL_DIR/boards/STM32F4DISC/Kconfig"
source "$MICROPYTHON_STMHAL_DIR/boards/STM32F411DISC/Kconfig"
endmenu
```

## stmhal/Kconfig.project
```kconfig
mainmenu "STMHAL Project Configuration"

config MICROPYTHON_DIR
       string
       default "../"

config MICROPYTHON_STMHAL_DIR
       string
       default "./"

source "$MICROPYTHON_DIR/Kconfig"
source "$MICROPYTHON_STMHAL_DIR/Kconfig"
```

## stmhal/boards/STM32F411DISC/Kconfig
```kconfig
if MICROPYTHON_STMHAL_BOARD_STM32F411DISC
config MICROPYTHON_STMHAL_AF_FILE
       string
       default "boards/stm32f411_af.csv"

config MICROPYTHON_STMHAL_LD_FILE
       string
       default "boards/stm32f411.ld"

config MICROPYTHON_STMHAL_BOARD_STM32F411DISC_DEFAULTS
       bool
       select MICROPYTHON_STMHAL_MCU_SERIES_STM32F4
       select MICROPYTHON_STMHAL_CMSIS_MCU_STM32F411XE
       default y
endif
```

## stmhal/boards/STM32F4DISC/Kconfig
```kconfig
if MICROPYTHON_STMHAL_BOARD_STM32F4DISC
config MICROPYTHON_STMHAL_BOARD
       string
       default "STM32F4DISC"

config MICROPYTHON_STMHAL_AF_FILE
       string
       default "boards/stm32f405_af.csv"


config MICROPYTHON_STMHAL_LD_FILE
       string
       default "boards/stm32f405.ld"

config MICROPYTHON_STMHAL_BOARD_STM32F4DISC_DEFAULTS
       bool
       select MICROPYTHON_STMHAL_MCU_SERIES_STM32F4
       select MICROPYTHON_STMHAL_CMSIS_MCU_STM32F407XX
       default y
endif
```
